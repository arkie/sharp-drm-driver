/dts-v1/;

/ {
	// compatible = "brcm,bcm2835", "brcm,bcm2708", "brcm,bcm2709";
	compatible = "raspberrypi,model-zero-2-w", "brcm,bcm2837";

	fragment@0 {
		target = <0xffffffff>;

		__overlay__ {
			status = "okay";

			spidev@0 {
				status = "disabled";
			};

			spidev@1 {
				status = "disabled";
			};
		};
	};

	fragment@1 {
		target = <0xffffffff>;

		__overlay__ {
			brcm,pins = <0x0a 0x0b>;
		};
	};

	fragment@2 {
		target = <0xffffffff>;

		__overlay__ {

			sharp_pins {
				brcm,pins = <0x17 0x16 0x12 0x11>;
				brcm,function = <0x01 0x01 0x01 0x00>;
				phandle = <0x01>;
			};
		};
	};

	fragment@3 {
		target = <0xffffffff>;

		__overlay__ {
			#address-cells = <0x01>;
			#size-cells = <0x00>;

			sharp_drm@0 {
				compatible = "sharp-drm";
				reg = <0x00>;
				pinctrl-names = "default";
				pinctrl-0 = <0x01>;
				vcom-gpios = <0xffffffff 0x17 0x00>;
				disp-gpios = <0xffffffff 0x16 0x00>;
				backlit-gpios = <0xffffffff 0x12 0x00>;
				spi-cs-high = <0x01>;
				spi-max-frequency = "", "=\t";
				buswidth = <0x08>;
				debug = <0x00>;
				interrupt-parent = <0xffffffff>;
				interrupts = <0x11 0x01>;
				phandle = <0x02>;
			};
		};
	};

	__symbols__ {
		sharp_pins = "/fragment@2/__overlay__/sharp_pins";
		sharp_drm = "/fragment@3/__overlay__/sharp_drm@0";
	};

	__fixups__ {
		spi0 = "/fragment@0:target:0", "/fragment@3:target:0";
		spi0_pins = "/fragment@1:target:0";
		gpio = "/fragment@2:target:0", "/fragment@3/__overlay__/sharp_drm@0:vcom-gpios:0", "/fragment@3/__overlay__/sharp_drm@0:disp-gpios:0", "/fragment@3/__overlay__/sharp_drm@0:backlit-gpios:0", "/fragment@3/__overlay__/sharp_drm@0:interrupt-parent:0";
	};

	__local_fixups__ {

		fragment@3 {

			__overlay__ {

				sharp_drm@0 {
					pinctrl-0 = <0x00>;
				};
			};
		};
	};
};
